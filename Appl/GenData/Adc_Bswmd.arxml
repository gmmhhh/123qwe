AUTOSAR XML (schema 00046)
# Copyright (C) Infineon Technologies (2021)
# All rights reserved.
package /AUTOSAR_Adc/BswModuleDescriptions
  bsw module description Adc: category=BSW_MODULE, module-id=123  # ADC Driver
    provided-entrys:
      Adc_Init
      Adc_SetupResultBuffer
      Adc_DeInit
      Adc_StartGroupConversion
      Adc_StopGroupConversion
      Adc_ReadGroup
      Adc_EnableHardwareTrigger
      Adc_DisableHardwareTrigger
      Adc_EnableGroupNotification
      Adc_DisableGroupNotification
      Adc_GetGroupStatus
      Adc_GetStreamLastPointer
      Adc_GetVersionInfo
      Adc_TriggerStartupCal
      Adc_GetStartupCalStatus
      Adc_RS{0..2}EventInterruptHandler
    bsw module dependency DetDependency: target-module-id=15, required-entrys=Det_ReportError
    bsw module dependency McuDependency: target-module-id=101
      required-entrys:
        Mcu_17_Gtm_AtomChannelInit
        Mcu_17_Gtm_AtomChannelEnable
        Mcu_17_Gtm_AtomChannelDeInit
        Mcu_17_Gtm_AtomChannelDisable
        Mcu_17_Gtm_AtomChannelShadowTransfer
        Mcu_17_Gtm_TomChannelInit
        Mcu_17_Gtm_TomChannelEnable
        Mcu_17_Gtm_TomChannelDeInit
        Mcu_17_Gtm_TomChannelDisable
        Mcu_17_Gtm_TomChannelShadowTransfer
        Mcu_17_Gtm_TomChInitCheck
        Mcu_17_Gtm_AtomChInitCheck
    bsw module dependency McalLibDependency: target-module-id=255
      required-entrys:
        Mcal_WritePeripEndInitProtReg
        Mcal_WriteSafetyEndInitProtRegMask
        Mcal_GetCpuIndex
        Mcal_GetBitAtomic
        Mcal_SetBitAtomic
    bsw internal behavior AdcBehavior
      exclusive area KernelData
      exclusive area SrcRegAccess
      13 x bsw called entity, all with reentrancy-level=MULTICORE-REENTRANT:
        Adc_Init: implemented-entry=Adc_Init
        Adc_SetupResultBuffer: can-enter-exclusive-area=KernelData, implemented-entry=Adc_SetupResultBuffer
        Adc_DeInit: implemented-entry=Adc_DeInit
        Adc_StartGroupConversion: can-enter-exclusive-area=[KernelData, SrcRegAccess], implemented-entry=Adc_StartGroupConversion
        Adc_StopGroupConversion: can-enter-exclusive-area=[KernelData, SrcRegAccess], implemented-entry=Adc_StopGroupConversion
        Adc_ReadGroup: can-enter-exclusive-area=KernelData, implemented-entry=Adc_ReadGroup
        Adc_EnableHardwareTrigger: can-enter-exclusive-area=[KernelData, SrcRegAccess], implemented-entry=Adc_EnableHardwareTrigger
        Adc_DisableHardwareTrigger: can-enter-exclusive-area=[KernelData, SrcRegAccess], implemented-entry=Adc_DisableHardwareTrigger
        Adc_EnableGroupNotification: implemented-entry=Adc_EnableGroupNotification
        Adc_DisableGroupNotification: implemented-entry=Adc_DisableGroupNotification
        Adc_GetGroupStatus: can-enter-exclusive-area=KernelData, implemented-entry=Adc_GetGroupStatus
        Adc_GetStreamLastPointer: can-enter-exclusive-area=KernelData, implemented-entry=Adc_GetStreamLastPointer
        Adc_GetVersionInfo: implemented-entry=Adc_GetVersionInfo
      bsw interrupt entity Adc_RS{0..2}EventInterruptHandler: can-enter-exclusive-area=[KernelData, SrcRegAccess], reentrancy-level=MULTICORE-REENTRANT, implemented-entry=Adc_RS{0..2}EventInterruptHandler
      bsw called entity Adc_TriggerStartupCal: reentrancy-level=NON-REENTRANT, implemented-entry=Adc_TriggerStartupCal
      bsw called entity Adc_GetStartupCalStatus: reentrancy-level=MULTICORE-REENTRANT, implemented-entry=Adc_GetStartupCalStatus
      service-needs:
        diagnostic event needs ADC_E_CLC_FAILURE
      service-needs:
        diagnostic event needs ADC_E_CONV_STOP_TIME_FAILURE
package /AUTOSAR_Adc/BswModuleEntrys
  18 x bsw module entry, all with sw-service-impl-policy=STANDARD:
    Adc_Init: service-id=0, is-reentrant=true, is-synchronous=true, call-type=REGULAR, execution-context=TASK
      sw service arg ConfigPtr: category=DATA_REFERENCE, sw-pointer-target-props={target-category=TYPE_REFERENCE, implementation-data-type=Adc_ConfigType}
    Adc_SetupResultBuffer: service-id=12, is-reentrant=true, is-synchronous=true, call-type=REGULAR, execution-context=TASK
      return type Return: implementation-data-type=Std_ReturnType
      sw service arg Group: implementation-data-type=Adc_GroupType
      sw service arg DataBufferPtr: category=DATA_REFERENCE, sw-pointer-target-props={target-category=TYPE_REFERENCE, implementation-data-type=Adc_ValueGroupType}
    Adc_DeInit: service-id=1, is-reentrant=true, is-synchronous=true, call-type=REGULAR, execution-context=TASK
    Adc_StartGroupConversion: service-id=2, is-reentrant=true, is-synchronous=false, call-type=REGULAR, execution-context=TASK
      sw service arg Group: implementation-data-type=Adc_GroupType
    Adc_StopGroupConversion: service-id=3, is-reentrant=true, is-synchronous=true, call-type=REGULAR, execution-context=TASK
      sw service arg Group: implementation-data-type=Adc_GroupType
    Adc_ReadGroup: service-id=4, is-reentrant=true, is-synchronous=true, call-type=REGULAR, execution-context=TASK
      return type Return: implementation-data-type=Std_ReturnType
      sw service arg Group: implementation-data-type=Adc_GroupType
      sw service arg DataBufferPtr: category=DATA_REFERENCE, sw-pointer-target-props={target-category=TYPE_REFERENCE, implementation-data-type=Adc_ValueGroupType}
    Adc_EnableHardwareTrigger: service-id=5, is-reentrant=true, is-synchronous=true, call-type=REGULAR, execution-context=TASK
      sw service arg Group: implementation-data-type=Adc_GroupType
    Adc_DisableHardwareTrigger: service-id=6, is-reentrant=true, is-synchronous=true, call-type=REGULAR, execution-context=TASK
      sw service arg Group: implementation-data-type=Adc_GroupType
    Adc_EnableGroupNotification: service-id=7, is-reentrant=true, is-synchronous=true, call-type=REGULAR, execution-context=TASK
      sw service arg Group: implementation-data-type=Adc_GroupType
    Adc_DisableGroupNotification: service-id=8, is-reentrant=true, is-synchronous=true, call-type=REGULAR, execution-context=TASK
      sw service arg Group: implementation-data-type=Adc_GroupType
    Adc_GetGroupStatus: service-id=9, is-reentrant=true, is-synchronous=true, call-type=REGULAR, execution-context=TASK
      return type Return: implementation-data-type=Adc_StatusType
      sw service arg Group: implementation-data-type=Adc_GroupType
    Adc_GetStreamLastPointer: service-id=11, is-reentrant=true, is-synchronous=true, call-type=REGULAR, execution-context=TASK
      return type Return: implementation-data-type=Adc_StreamNumSampleType
      sw service arg Group: implementation-data-type=Adc_GroupType
      sw service arg PtrToSamplePtr: category=DATA_REFERENCE, sw-pointer-target-props={target-category=TYPE_REFERENCE, implementation-data-type=Adc_ValueGroupType}
    Adc_GetVersionInfo: service-id=10, is-reentrant=true, is-synchronous=true, call-type=REGULAR, execution-context=TASK
      sw service arg versioninfo: category=DATA_REFERENCE, sw-pointer-target-props={target-category=TYPE_REFERENCE, implementation-data-type=Std_VersionInfoType}
    Adc_GetStartupCalStatus: service-id=48, is-reentrant=true, is-synchronous=true, call-type=REGULAR, execution-context=TASK
      return type Return: implementation-data-type=Adc_StartupCalibStatusType
    Adc_TriggerStartupCal: service-id=49, is-reentrant=false, is-synchronous=false, call-type=REGULAR, execution-context=TASK
      return type Return: implementation-data-type=Std_ReturnType
    Adc_RS0EventInterruptHandler: service-id=51, is-reentrant=true, is-synchronous=true, call-type=INTERRUPT, execution-context=INTERRUPT-CAT-1
      sw service arg KernelId: implementation-data-type=uint32
    Adc_RS1EventInterruptHandler: service-id=52, is-reentrant=true, is-synchronous=true, call-type=INTERRUPT, execution-context=INTERRUPT-CAT-1
      sw service arg KernelId: implementation-data-type=uint32
    Adc_RS2EventInterruptHandler: service-id=53, is-reentrant=true, is-synchronous=true, call-type=INTERRUPT, execution-context=INTERRUPT-CAT-1
      sw service arg KernelId: implementation-data-type=uint32
package /AUTOSAR_Adc/Implementations
  bsw implementation Adc: programming-language=C, sw-version=20.10.0, vendor-id=17, ar-release-version=4.4.0, behavior=AdcBehavior, vendor-specific-module-def=Adc
    code-descriptors:
      code Files: artifact-descriptors=[{short-label=ssc::src::Adc.c, category=SWSRC}, {short-label=ssc::inc::Adc.h, category=SWHDR}]
    generated-artifacts:
      4 x dependency on artifact:
        Adc_PBcfg_c: artifact-descriptor={short-label=generate::template::src::Adc_PBcfg.c, category=SWTEMPLATE}, usages=EXECUTE
        Adc_PBcfg_h: artifact-descriptor={short-label=generate::template::inc::Adc_PBcfg.h, category=SWTEMPLATE}, usages=EXECUTE
        Adc_Cfg_h: artifact-descriptor={short-label=generate::template::inc::Adc_Cfg.h, category=SWTEMPLATE}, usages=COMPILE
        Adc_bmd: artifact-descriptor={short-label=autosar::TC38x::TC387x::Adc.bmd, category=SWTOOL}, usages=CODEGENERATION
    resource consumption ResourceConsumption
      9 x memory section:
        CONFIG_DATA_ASIL_B_CORE0_UNSPECIFIED: alignment=UNSPECIFIED, sw-addrmethod=CONFIG_DATA
        VAR_CLEARED_ASIL_B_CORE0_UNSPECIFIED: alignment=UNSPECIFIED, sw-addrmethod=VAR_CLEARED
        CONFIG_DATA_ASIL_B_CORE2_UNSPECIFIED: alignment=UNSPECIFIED, sw-addrmethod=CONFIG_DATA
        VAR_CLEARED_ASIL_B_CORE2_UNSPECIFIED: alignment=UNSPECIFIED, sw-addrmethod=VAR_CLEARED
        CONFIG_DATA_ASIL_B_GLOBAL_UNSPECIFIED: alignment=UNSPECIFIED, sw-addrmethod=CONFIG_DATA
        CODE_ASIL_B_GLOBAL: alignment=UNSPECIFIED, sw-addrmethod=CODE
        VAR_CLEARED_ASIL_B_GLOBAL_32: alignment=32, sw-addrmethod=VAR_CLEARED
        CONST_ASIL_B_GLOBAL_8: alignment=8, sw-addrmethod=CONST
        CONST_ASIL_B_GLOBAL_UNSPECIFIED: alignment=UNSPECIFIED, sw-addrmethod=CONST
      section name prefix ADC
package /AUTOSAR_Adc/ImplementationDataTypes
  34 x impl type, all with type-emitter=BSW:
    Adc_ChannelRangeSelectType: compu {0=ADC_RANGE_UNDER_LOW, 1=ADC_RANGE_BETWEEN, 2=ADC_RANGE_OVER_HIGH, 3=ADC_RANGE_ALWAYS, 4=ADC_RANGE_NOT_UNDER_LOW, 5=ADC_RANGE_NOT_BETWEEN, 6=ADC_RANGE_NOT_OVER_HIGH}, implementation-data-type=sint32, additional-native-type-qualifier=enum
    Adc_ChannelType: implementation-data-type=uint8
    Adc_ConversionTimeType: implementation-data-type=uint8
    Adc_GroupAccessModeType: implementation-data-type=uint8
    Adc_GroupConvModeType: implementation-data-type=uint8
    Adc_GroupPriorityType: implementation-data-type=uint8
    Adc_GroupReplacementType: implementation-data-type=uint8
    Adc_GroupType: implementation-data-type=uint16
    Adc_HwTriggerSignalType: implementation-data-type=uint8
    Adc_HwTriggerTimerType: implementation-data-type=uint16
    Adc_NotifyFnPtrType: category=FUNCTION_REFERENCE, sw-pointer-target-props=IoHwAb_AdcNotification
    Adc_PrescaleType: implementation-data-type=uint8
    Adc_PriorityImplementationType: implementation-data-type=uint8
    Adc_ResolutionType: implementation-data-type=uint8
    Adc_ResultAlignmentType: implementation-data-type=uint8
    Adc_SamplingTimeType: implementation-data-type=uint8
    Adc_StartupCalibStatusType: compu {0=ADC_STARTUP_CALIB_NOT_TRIGGERED, 1=ADC_STARTUP_CALIB_ONGOING, 2=ADC_STARTUP_CALIB_OVER}, implementation-data-type=uint8
    Adc_StatusType: compu {0=ADC_IDLE, 1=ADC_BUSY, 2=ADC_COMPLETED, 3=ADC_STREAM_COMPLETED}, implementation-data-type=uint8
    Adc_StreamBufferModeType: implementation-data-type=uint8
    Adc_StreamNumSampleType: implementation-data-type=uint8
    Adc_SyncConvModeType: implementation-data-type=uint8
    Adc_TriggerSourceType: implementation-data-type=uint8
    Adc_ValueGroupType: implementation-data-type=uint16
    Adc_ChannelCfgType: category=STRUCTURE
      4 x element, all with category=TYPE_REFERENCE:
        ChannelChctrCfg: implementation-data-type=uint32
        BoundaryValues: implementation-data-type=uint32
        AnChannelNo: implementation-data-type=Adc_ChannelType
        LimitCheckEnabled: implementation-data-type=uint8
    Adc_ConfigType: category=STRUCTURE
      element GlobalCfgPtr: category=DATA_REFERENCE, sw-pointer-target-props={target-category=TYPE_REFERENCE, implementation-data-type=Adc_GlobalCfgType}
      element CoreCfgPtr: category=DATA_REFERENCE, array-size=4, array-size-semantics=FIXED-SIZE, sw-pointer-target-props={target-category=TYPE_REFERENCE, implementation-data-type=Adc_CoreConfigType}
    Adc_CoreConfigType: category=STRUCTURE
      element HwUnitCfgPtr: category=DATA_REFERENCE, array-size=12, array-size-semantics=FIXED-SIZE, sw-pointer-target-props={target-category=TYPE_REFERENCE, implementation-data-type=Adc_HwUnitCfgType}
    Adc_EruChannelCfgType: category=STRUCTURE
      4 x element, all with category=TYPE_REFERENCE:
        EruEicrCfg: implementation-data-type=uint16
        EruIgcrCfg: implementation-data-type=uint16
        ErsChannel: implementation-data-type=uint8
        OguChannel: implementation-data-type=uint8
    Adc_GlobalCfgType: category=STRUCTURE
      4 x element, all with category=TYPE_REFERENCE, implementation-data-type=uint32:
        GlobalCfg
        GlobInputClass0Cfg
        GlobInputClass1Cfg
        GlobEmuxGrpInterfaceCfg
    Adc_GroupCfgType: category=STRUCTURE
      26 x element:
        NotifyPtr: implementation-data-type=Adc_NotifyFnPtrType
        GroupDefinition: category=DATA_REFERENCE, sw-pointer-target-props={target-category=TYPE_REFERENCE, implementation-data-type=Adc_GroupDefType}
        GtmTrigCfg: category=DATA_REFERENCE, sw-pointer-target-props={target-category=TYPE_REFERENCE, implementation-data-type=Mcu_17_Gtm_TomAtomChConfigType}
        GtmGateCfg: category=DATA_REFERENCE, sw-pointer-target-props={target-category=TYPE_REFERENCE, implementation-data-type=Mcu_17_Gtm_TomAtomChConfigType}
        EruTrigCfg: category=DATA_REFERENCE, sw-pointer-target-props={target-category=TYPE_REFERENCE, implementation-data-type=Adc_EruChannelCfgType}
        EruGateCfg: category=DATA_REFERENCE, sw-pointer-target-props={target-category=TYPE_REFERENCE, implementation-data-type=Adc_EruChannelCfgType}
        GroupQCtrlCfg: implementation-data-type=uint32
        GroupQModeCfg: implementation-data-type=uint32
        AliasChCfg: implementation-data-type=uint32
        GrpReqTmCfg: implementation-data-type=uint32
        ChannelMask: implementation-data-type=uint16
        ResultRegMask: implementation-data-type=uint16
        SyncChannelMask: implementation-data-type=uint16
        SyncResRegMask: implementation-data-type=uint16
        TriggerSource: implementation-data-type=Adc_TriggerSourceType
        ConvMode: implementation-data-type=Adc_GroupConvModeType
        AccessMode: implementation-data-type=Adc_GroupAccessModeType
        StreamMode: implementation-data-type=Adc_StreamBufferModeType
        NumOfSamples: implementation-data-type=Adc_StreamNumSampleType
        HwTrigType: implementation-data-type=Adc_HwTrigGateType
        HwGateType: implementation-data-type=Adc_HwTrigGateType
        GrpPriority: implementation-data-type=uint8
        NoOfChannels: implementation-data-type=uint8
        LimitCheckGroup: implementation-data-type=uint8
        GrpEmuxCfg: implementation-data-type=uint8
        DiagnosticChGrp: implementation-data-type=uint8
    Adc_GroupDefType: category=STRUCTURE
      4 x element, all with category=TYPE_REFERENCE:
        ASChannelId: implementation-data-type=Adc_ChannelType
        AnalogChannelNo: implementation-data-type=Adc_ChannelType
        ResultReg: implementation-data-type=Adc_ResultRegType
        AnChDiagnosticsCfg: implementation-data-type=uint32
    Adc_HwCfgType: category=STRUCTURE
      6 x element, all with category=TYPE_REFERENCE, implementation-data-type=uint32:
        GrpAnalogFuncCfg
        GrpArbitCfg
        GrpArbitPrioCfg
        KernelInputClass0Cfg
        KernelInputClass1Cfg
        GrpSyncCtrlCfg
    Adc_HwTrigGateType: implementation-data-type=uint8
    Adc_HwUnitCfgType: category=STRUCTURE
      9 x element:
        HwCfgPtr: category=DATA_REFERENCE, sw-pointer-target-props={target-category=TYPE_REFERENCE, implementation-data-type=Adc_HwCfgType}
        ChCfgPtr: category=DATA_REFERENCE, sw-pointer-target-props={target-category=TYPE_REFERENCE, implementation-data-type=Adc_ChannelCfgType}
        GrpCfgPtr: category=DATA_REFERENCE, sw-pointer-target-props={target-category=TYPE_REFERENCE, implementation-data-type=Adc_GroupCfgType}
        SwTrigGrpMask: implementation-data-type=uint32
        HwTrigGrpMask: implementation-data-type=uint32
        SyncConvMode: implementation-data-type=Adc_SyncConvModeType
        SlaveKernels: array-size=3, array-size-semantics=FIXED-SIZE, implementation-data-type=uint8
        NoOfGroups: implementation-data-type=uint8
        SRNUsed: implementation-data-type=uint8
    Adc_ResultRegType: implementation-data-type=uint8
